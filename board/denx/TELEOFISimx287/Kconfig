## board/denx/TELEOFISimx287/Kconfig
```kconfig
if TARGET_TELEOFISimx287

config SYS_CPU
	default "arm926ejs"

config SYS_BOARD
	default "TELEOFISimx287"

config SYS_VENDOR
	default "denx"

config SYS_SOC
	default "mxs"

config SYS_CONFIG_NAME
	default "TELEOFISimx287"

endif
```

## configs/TELEOFISimx287_nand_defconfig
```kconfig
CONFIG_SPL=y
CONFIG_SYS_EXTRA_OPTIONS="ENV_IS_IN_NAND,MXS_AUART,MXS_AUART_BASE=MXS_UARTAPP4_BASE"
+S:CONFIG_ARM=y
+S:CONFIG_TARGET_TELEOFISimx287=y
```
